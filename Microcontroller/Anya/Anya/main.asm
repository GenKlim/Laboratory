.def temp=R17 ;присваиваем символическое имя регистру
.def D=R20	// регистр для таймера
.def TIMER=R21	// рагистр - флаг, нужен что бы определить когда сработал таймер

// Биндим входы порта С в соответствии с цветами
.equ LED_B_R = 0b00000001	//Красный
.equ LED_B_Y = 0b00000010	//Желтый
.equ LED_B_G = 0b00000100	//Зеленый
.equ LED_S_G = 0b00001000	//Зеленый для пешеходов
.equ LED_S_R = 0b00010000	//Красный для пешеходов

// Макрос
// Первым параметром принемает щадержку в секундах, вторым значение которое надо передать на порт С
.macro show
	ldi temp, @1	//	Загружаем на порт С то, что было во втором параметре макроса
	out PORTC, temp
	ldi D, (16*@0)-1	//	Умножаем первый пораметр макрома (задержку в секундах) на неведомым образом полученую константу
	rcall delay_loop//	Вызываем ожидание таймера
.endm

.dseg
.cseg

// Настраиваем вектор прирываний
.org 0	// Прерывание сброса, как я понимаю
	rjmp Init

.org OVF0addr	//Прирывание, вызвваемое переполнением нулевого таймера
	rjmp OnTimer0_Overflow

.org INT_VECTORS_SIZE	

// Инициализация
Init:
	ldi temp, 0xff ; настраиваем порт C на выход
	out DDRC, temp

	ldi r16, (1<<CS02)	// Устанавливаем делитель частоты таймера 256
	out TCCR0, r16
	
	ldi r16, 1<<TOV0	// Как я понял, это включает нулевой таймер. А может и все таймеры сразу
	out TIFR, r16

	ldi r16, 1<<TOIE0	// Включаем прерывание нулевого таймера по переполнению
	out TIMSK, r16
	sei	// Разрешаем все прерывания

// Основной кусок
program:
	show 16, LED_B_R | LED_S_G	// включаем красный для машин и зеленый для пешеходов
	show 2, LED_B_R	// только красный
	show 2, LED_B_R | LED_S_G // опять красный и зеленый, мигаем
	show 2, LED_B_R
	show 2, LED_B_R | LED_S_G
	show 2, LED_B_R
	show 2, LED_B_R | LED_S_G

	show 2, LED_B_Y | LED_S_R
	// далее по образу и подобию
	// максимальная задержка 16сек !!!

	rjmp program

OnTimer0_Overflow:	// тик таймера
	ldi TIMER, 0xff	// устанавливаем флаг таймера
	reti	//возврат из прирывания
 
 // ждет таймер столько раз, сколько записано в D
delay_loop:
	cpi TIMER, 0xff
	brne delay_loop
	ldi TIMER, 0x00
	dec D
	brne delay_loop
	ret
